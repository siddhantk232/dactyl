#include "dactyl_56.dtsi" // Notice that the main dtsi files are included in the overlay.

&kscan0 {
    col-gpios
        = <&gpio0 22 GPIO_ACTIVE_HIGH>
        , <&gpio0 24 GPIO_ACTIVE_HIGH>
        , <&gpio1 0  GPIO_ACTIVE_HIGH>
        , <&gpio0 11 GPIO_ACTIVE_HIGH>
        , <&gpio1 4  GPIO_ACTIVE_HIGH>
        , <&gpio1 6  GPIO_ACTIVE_HIGH>
        ;

    row-gpios
        = <&gpio0 2  (GPIO_ACTIVE_HIGH | GPIO_PULL_DOWN)>
        , <&gpio1 15 (GPIO_ACTIVE_HIGH | GPIO_PULL_DOWN)>
        , <&gpio1 13 (GPIO_ACTIVE_HIGH | GPIO_PULL_DOWN)>
        , <&gpio1 11 (GPIO_ACTIVE_HIGH | GPIO_PULL_DOWN)>
        , <&gpio0 10 (GPIO_ACTIVE_HIGH | GPIO_PULL_DOWN)>
        , <&gpio0 9  (GPIO_ACTIVE_HIGH | GPIO_PULL_DOWN)>
        ;
};
