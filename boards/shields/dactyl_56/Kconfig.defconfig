## boards/shields/dactyl_56/Kconfig.defconfig
```kconfig
if SHIELD_DACTYL_56_LEFT

    # Name must be less than 16 characters long!
    config ZMK_KEYBOARD_NAME
        default "Dactyl 56"

    config ZMK_SPLIT_BLE_ROLE_CENTRAL
        default y

endif

if SHIELD_DACTYL_56_RIGHT

    config ZMK_KEYBOARD_NAME
        default "Dactyl 56 Right"

endif

if SHIELD_DACTYL_56_LEFT || SHIELD_DACTYL_56_RIGHT

    config ZMK_SPLIT
        default y

endif
```

## config/boards/shields/dactyl_56/Kconfig.shield
```kconfig
# No whitespace after the comma or in your part name!
config SHIELD_DACTYL_56_LEFT
    def_bool $(shields_list_contains,dactyl_56_left)

# No whitespace after the comma or in your part name!
config SHIELD_DACTYL_56_RIGHT
    def_bool $(shields_list_contains,dactyl_56_right)
```
